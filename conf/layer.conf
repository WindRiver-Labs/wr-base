## conf/layer.conf
```bitbake
#
# Copyright (C) 2013 Wind River Systems, Inc.
#
# We have a conf and classes directory, add to BBPATH
BBPATH =. "${LAYERDIR}:"

LAYER_PATH_wr-base = "${LAYERDIR}"

# We have a packages directory, add to BBFILES
BBFILES += "${LAYERDIR}/recipes-*/*/*.bb \
	${LAYERDIR}/recipes-*/*/*.bbappend"

BBFILE_COLLECTIONS += "wr-userspace-base"
BBFILE_PATTERN_wr-userspace-base = "^${LAYERDIR}/"
BBFILE_PRIORITY_wr-userspace-base = "6"

# This should only be incremented on significant changes that will
# cause compatibility issues with other layers
LAYERVERSION_wr-userspace-base = "1"

LAYERDEPENDS_wr-userspace-base = "\
     core \
     perl-layer \
     meta-initramfs \
     meta-python \
     networking-layer \
     openembedded-layer \
     webserver \
     wr-template \
"

LAYERRECOMMENDS_wr-userspace-base = "\
     wrlinux \
     wr-base-dl \
"

require wrlinux-blacklist.conf
require wrlinux-whitelist.conf
require wrlinux-exclude-from-world.conf
```
